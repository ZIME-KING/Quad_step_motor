/**
 * @file Motor34_position_control_example.c
 * @brief 步进电机34位置控制系统使用示例
 * @author Generated by AI Assistant
 * @date 2024
 */

#include "control.h"
#include "main.h"
#include <stdio.h>

/**
 * @brief 步进电机34位置控制基本使用示例
 * 演示如何设置目标位置并让电机自动运行到目标位置
 */
void Motor34_Basic_Position_Control_Example(void)
{
    printf("=== 步进电机34位置控制基本示例 ===\r\n");
    
    // 1. 初始化位置控制系统
    Motor34_ResetPosition(); // 复位位置为0
    Motor34_SetMaxStepsPerCycle(50); // 设置每20ms最大50步
    Motor34_EnablePositionControl(); // 启用位置控制
    
    printf("位置控制系统已初始化\r\n");
    printf("当前位置: %ld\r\n", Motor34_GetCurrentPosition());
    printf("每周期最大步数: %d\r\n", Motor34_GetMaxStepsPerCycle());
    
    // 2. 设置目标位置并观察运动
    int32_t target_positions[] = {100, 500, -200, 0, 1000};
    int num_targets = sizeof(target_positions) / sizeof(target_positions[0]);
    
    for (int i = 0; i < num_targets; i++) {
        printf("\r\n--- 目标位置 %d: %ld ---\r\n", i+1, target_positions[i]);
        
        // 设置新的目标位置
        Motor34_SetTargetPosition(target_positions[i]);
        printf("设置目标位置: %ld\r\n", Motor34_GetTargetPosition());
        
        // 模拟20ms周期调用位置控制函数
        int cycle_count = 0;
        while (!Motor34_IsAtTargetPosition() && cycle_count < 200) { // 最多4秒
            printf("周期 %d - 当前位置: %ld, 误差: %ld\r\n", 
                   cycle_count, Motor34_GetCurrentPosition(), Motor34_GetPositionError());
            
            // 调用位置控制函数 (实际使用中应在20ms定时器中断中调用)
            Motor34_PositionControl();
            
            // 模拟20ms延时
            HAL_Delay(20);
            cycle_count++;
        }
        
        if (Motor34_IsAtTargetPosition()) {
            printf("✓ 已到达目标位置: %ld\r\n", Motor34_GetCurrentPosition());
        } else {
            printf("⚠ 超时未到达目标位置\r\n");
        }
    }
    
    printf("\r\n基本位置控制示例完成\r\n");
}

/**
 * @brief 步进电机34动态位置控制示例
 * 演示在运行过程中动态改变目标位置
 */
void Motor34_Dynamic_Position_Control_Example(void)
{
    printf("=== 步进电机34动态位置控制示例 ===\r\n");
    
    // 初始化
    Motor34_ResetPosition();
    Motor34_SetMaxStepsPerCycle(30);
    Motor34_EnablePositionControl();
    
    printf("开始动态位置控制...\r\n");
    
    // 模拟动态改变目标位置
    for (int cycle = 0; cycle < 100; cycle++) {
        // 每10个周期改变一次目标位置
        if (cycle % 10 == 0) {
            int32_t new_target = (cycle / 10) * 100 - 200; // -200, -100, 0, 100, 200...
            Motor34_SetTargetPosition(new_target);
            printf("\r\n周期 %d: 新目标位置 %ld\r\n", cycle, new_target);
        }
        
        // 显示当前状态
        if (cycle % 5 == 0) {
            printf("当前: %ld, 目标: %ld, 误差: %ld\r\n", 
                   Motor34_GetCurrentPosition(), 
                   Motor34_GetTargetPosition(), 
                   Motor34_GetPositionError());
        }
        
        // 执行位置控制
        Motor34_PositionControl();
        
        // 模拟20ms延时
        HAL_Delay(20);
    }
    
    printf("\r\n动态位置控制示例完成\r\n");
}

/**
 * @brief 步进电机34位置控制参数调整示例
 * 演示如何调整控制参数以获得不同的运动特性
 */
void Motor34_Parameter_Adjustment_Example(void)
{
    printf("=== 步进电机34参数调整示例 ===\r\n");
    
    Motor34_ResetPosition();
    Motor34_EnablePositionControl();
    
    // 测试不同的最大步数设置
    uint16_t max_steps_values[] = {10, 50, 100, 200};
    int num_values = sizeof(max_steps_values) / sizeof(max_steps_values[0]);
    
    for (int i = 0; i < num_values; i++) {
        printf("\r\n--- 测试最大步数: %d ---\r\n", max_steps_values[i]);
        
        // 设置新的最大步数
        Motor34_SetMaxStepsPerCycle(max_steps_values[i]);
        printf("设置每周期最大步数: %d\r\n", Motor34_GetMaxStepsPerCycle());
        
        // 复位位置并设置目标
        Motor34_ResetPosition();
        Motor34_SetTargetPosition(500);
        
        // 记录到达目标位置所需的时间
        int cycles = 0;
        uint32_t start_time = HAL_GetTick();
        
        while (!Motor34_IsAtTargetPosition() && cycles < 100) {
            Motor34_PositionControl();
            HAL_Delay(20);
            cycles++;
        }
        
        uint32_t end_time = HAL_GetTick();
        printf("到达目标用时: %lu ms, 周期数: %d\r\n", end_time - start_time, cycles);
        
        if (Motor34_IsAtTargetPosition()) {
            printf("✓ 成功到达目标位置\r\n");
        } else {
            printf("⚠ 未能在规定时间内到达\r\n");
        }
    }
    
    printf("\r\n参数调整示例完成\r\n");
}

/**
 * @brief 步进电机34位置校准示例
 * 演示如何进行位置校准和零点设置
 */
void Motor34_Position_Calibration_Example(void)
{
    printf("=== 步进电机34位置校准示例 ===\r\n");
    
    Motor34_EnablePositionControl();
    Motor34_SetMaxStepsPerCycle(20);
    
    // 模拟寻找零点过程
    printf("开始寻找零点...\r\n");
    
    // 假设向负方向移动寻找限位开关
    Motor34_SetTargetPosition(-1000); // 向负方向移动
    
    for (int i = 0; i < 50; i++) {
        Motor34_PositionControl();
        
        // 模拟检测到限位开关 (实际应用中应检测GPIO)
        if (Motor34_GetCurrentPosition() <= -500) {
            printf("检测到零点限位开关\r\n");
            break;
        }
        
        HAL_Delay(20);
    }
    
    // 设置当前位置为零点
    Motor34_SetCurrentPosition(0);
    Motor34_SetTargetPosition(0);
    printf("零点校准完成，当前位置: %ld\r\n", Motor34_GetCurrentPosition());
    
    // 测试校准后的运动
    printf("\r\n测试校准后的位置控制...\r\n");
    int32_t test_positions[] = {100, 200, 50, 0};
    
    for (int i = 0; i < 4; i++) {
        Motor34_SetTargetPosition(test_positions[i]);
        printf("移动到位置: %ld\r\n", test_positions[i]);
        
        while (!Motor34_IsAtTargetPosition()) {
            Motor34_PositionControl();
            HAL_Delay(20);
        }
        
        printf("到达位置: %ld\r\n", Motor34_GetCurrentPosition());
        HAL_Delay(500); // 停留0.5秒
    }
    
    printf("\r\n位置校准示例完成\r\n");
}

/**
 * @brief 在定时器中断中使用位置控制的示例
 * 这个函数应该在20ms定时器中断服务程序中调用
 */
void Motor34_Timer_Interrupt_Handler(void)
{
    // 在定时器中断中调用位置控制函数
    Motor34_PositionControl();
    
    // 可选：添加状态监控
    static int interrupt_count = 0;
    interrupt_count++;
    
    // 每秒输出一次状态 (50 * 20ms = 1000ms)
    if (interrupt_count >= 50) {
        interrupt_count = 0;
        
        // 在实际应用中，可以设置标志位在主循环中输出，避免在中断中使用printf
        // printf("位置: %ld, 目标: %ld\r\n", 
        //        Motor34_GetCurrentPosition(), Motor34_GetTargetPosition());
    }
}

/**
 * @brief 完整的位置控制应用示例
 * 演示一个完整的位置控制应用流程
 */
void Motor34_Complete_Application_Example(void)
{
    printf("=== 步进电机34完整应用示例 ===\r\n");
    
    // 1. 系统初始化
    printf("1. 系统初始化\r\n");
    Motor34_ResetPosition();
    Motor34_SetMaxStepsPerCycle(50);
    Motor34_EnablePositionControl();
    
    // 2. 位置校准
    printf("2. 位置校准\r\n");
    // 这里可以添加实际的校准代码
    
    // 3. 执行预定义的运动序列
    printf("3. 执行运动序列\r\n");
    int32_t motion_sequence[] = {0, 100, 300, 150, 400, 0};
    int sequence_length = sizeof(motion_sequence) / sizeof(motion_sequence[0]);
    
    for (int i = 0; i < sequence_length; i++) {
        printf("步骤 %d: 移动到位置 %ld\r\n", i+1, motion_sequence[i]);
        
        Motor34_SetTargetPosition(motion_sequence[i]);
        
        // 等待到达目标位置
        while (!Motor34_IsAtTargetPosition()) {
            Motor34_PositionControl();
            HAL_Delay(20);
        }
        
        printf("✓ 到达位置 %ld\r\n", Motor34_GetCurrentPosition());
        HAL_Delay(1000); // 停留1秒
    }
    
    // 4. 系统关闭
    printf("4. 系统关闭\r\n");
    Motor34_DisablePositionControl();
    
    printf("\r\n完整应用示例完成\r\n");
}