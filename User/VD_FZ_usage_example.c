/**
 * @file VD_FZ_usage_example.c
 * @brief VD_FZ次数控制功能使用示例
 * @author Generated by AI Assistant
 * @date 2024
 */

#include "control.h"
#include "main.h"
#include <stdio.h>

/**
 * @brief VD_FZ次数控制使用示例
 * 演示如何使用VD_FZ的次数控制功能
 */
void VD_FZ_Usage_Example(void)
{
    // 示例1: 设置VD_FZ执行10次
    printf("=== VD_FZ次数控制示例 ===\r\n");
    
    // 设置目标执行次数为10次
    VD_FZ_SetTargetCount(10);
    printf("设置VD_FZ目标执行次数: %d\r\n", VD_FZ_GetTargetCount());
    
    // 启用次数控制
    VD_FZ_Enable();
    printf("已启用VD_FZ次数控制\r\n");
    
    // 模拟在定时器中断或主循环中调用VD_FZ
    for (int i = 0; i < 15; i++) {
        printf("第%d次调用VD_FZ前 - 当前次数: %d\r\n", i+1, VD_FZ_GetCurrentCount());
        
        VD_FZ(); // 调用VD_FZ函数
        
        printf("第%d次调用VD_FZ后 - 当前次数: %d\r\n", i+1, VD_FZ_GetCurrentCount());
        
        // 检查是否已完成目标次数
        if (VD_FZ_IsCompleted()) {
            printf("VD_FZ已完成目标次数，后续调用将被忽略\r\n");
        }
        
        // 添加一些延时（实际使用中可能在定时器中断中调用）
        HAL_Delay(100);
    }
    
    printf("\r\n=== 重置次数示例 ===\r\n");
    
    // 重置执行次数
    VD_FZ_ResetCount();
    printf("已重置VD_FZ执行次数，当前次数: %d\r\n", VD_FZ_GetCurrentCount());
    
    // 再次执行几次
    for (int i = 0; i < 5; i++) {
        VD_FZ();
        printf("重置后第%d次执行，当前次数: %d\r\n", i+1, VD_FZ_GetCurrentCount());
        HAL_Delay(100);
    }
    
    printf("\r\n=== 禁用次数控制示例 ===\r\n");
    
    // 禁用次数控制
    VD_FZ_Disable();
    printf("已禁用VD_FZ次数控制\r\n");
    
    // 禁用后VD_FZ将正常执行，不受次数限制
    for (int i = 0; i < 3; i++) {
        VD_FZ();
        printf("禁用控制后第%d次执行\r\n", i+1);
        HAL_Delay(100);
    }
    
    printf("VD_FZ次数控制示例完成\r\n");
}

/**
 * @brief 在定时器中断中使用VD_FZ的示例
 * 这个函数可以在定时器中断服务程序中调用
 */
void VD_FZ_Timer_Interrupt_Example(void)
{
    // 在定时器中断中调用VD_FZ
    // 次数控制会自动生效
    VD_FZ();
    
    // 可选：检查是否完成
    if (VD_FZ_IsCompleted()) {
        // 完成后可以执行其他操作
        // 例如：停止定时器、设置标志位等
    }
}