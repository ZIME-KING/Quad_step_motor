/**
 * @file Motor34_position_monitor_example.c
 * @brief 步进电机34位置监控示例 - 演示如何打印当前位置和目标位置
 * @author Generated by AI Assistant
 * @date 2024
 */

#include "control.h"
#include "main.h"
#include <stdio.h>

/**
 * @brief 基本位置监控示例
 * 演示如何使用Motor34_PrintPositions()函数监控电机状态
 */
void Motor34_Basic_Position_Monitor_Example(void)
{
    printf("=== 步进电机34基本位置监控示例 ===\r\n\r\n");
    
    // 初始化位置控制系统
    Motor34_ResetPosition();
    Motor34_SetMaxStepsPerCycle(50);
    Motor34_EnablePositionControl();
    
    printf("1. 初始状态\r\n");
    Motor34_PrintPositions();
    HAL_Delay(1000);
    
    // 设置第一个目标位置
    printf("\r\n2. 设置目标位置为200\r\n");
    Motor34_SetTargetPosition(200);
    Motor34_PrintPositions();
    
    // 模拟运动过程，每隔几个周期打印一次位置信息
    printf("\r\n3. 运动过程监控\r\n");
    int cycle = 0;
    while (!Motor34_IsAtTargetPosition() && cycle < 20) {
        if (cycle % 3 == 0) { // 每3个周期打印一次
            printf("\r\n--- 周期 %d ---\r\n", cycle);
            Motor34_PrintPositions();
        }
        
        Motor34_PositionControl();
        HAL_Delay(20);
        cycle++;
    }
    
    printf("\r\n4. 到达目标位置\r\n");
    Motor34_PrintPositions();
    HAL_Delay(1000);
    
    // 设置新的目标位置（负方向）
    printf("\r\n5. 设置目标位置为-100（负方向）\r\n");
    Motor34_SetTargetPosition(-100);
    Motor34_PrintPositions();
    
    // 再次监控运动过程
    printf("\r\n6. 负方向运动过程监控\r\n");
    cycle = 0;
    while (!Motor34_IsAtTargetPosition() && cycle < 25) {
        if (cycle % 4 == 0) { // 每4个周期打印一次
            printf("\r\n--- 周期 %d ---\r\n", cycle);
            Motor34_PrintPositions();
        }
        
        Motor34_PositionControl();
        HAL_Delay(20);
        cycle++;
    }
    
    printf("\r\n7. 最终状态\r\n");
    Motor34_PrintPositions();
    
    Motor34_DisablePositionControl();
    printf("\r\n基本位置监控示例完成\r\n");
}

/**
 * @brief 实时位置监控示例
 * 演示连续监控位置变化
 */
void Motor34_Realtime_Position_Monitor_Example(void)
{
    printf("=== 步进电机34实时位置监控示例 ===\r\n\r\n");
    
    // 初始化
    Motor34_ResetPosition();
    Motor34_SetMaxStepsPerCycle(30);
    Motor34_EnablePositionControl();
    
    // 设置一系列目标位置
    int32_t targets[] = {100, 300, 150, -50, 0};
    int num_targets = sizeof(targets) / sizeof(targets[0]);
    
    for (int i = 0; i < num_targets; i++) {
        printf("\r\n=== 目标 %d: %ld ===\r\n", i+1, targets[i]);
        Motor34_SetTargetPosition(targets[i]);
        
        // 打印初始状态
        printf("设置目标后的状态:\r\n");
        Motor34_PrintPositions();
        
        // 实时监控运动过程
        int cycle = 0;
        while (!Motor34_IsAtTargetPosition() && cycle < 50) {
            // 每2个周期打印一次简化信息
            if (cycle % 2 == 0) {
                printf("周期%2d: 当前=%4ld, 目标=%4ld, 误差=%4ld\r\n", 
                       cycle, 
                       Motor34_GetCurrentPosition(), 
                       Motor34_GetTargetPosition(), 
                       Motor34_GetPositionError());
            }
            
            Motor34_PositionControl();
            HAL_Delay(20);
            cycle++;
        }
        
        // 打印到达目标后的详细状态
        printf("\r\n到达目标后的状态:\r\n");
        Motor34_PrintPositions();
        HAL_Delay(500);
    }
    
    Motor34_DisablePositionControl();
    printf("\r\n实时位置监控示例完成\r\n");
}

/**
 * @brief 位置监控调试示例
 * 演示如何使用位置打印功能进行调试
 */
void Motor34_Position_Debug_Example(void)
{
    printf("=== 步进电机34位置监控调试示例 ===\r\n\r\n");
    
    // 测试各种状态下的位置信息
    printf("1. 测试禁用状态\r\n");
    Motor34_DisablePositionControl();
    Motor34_PrintPositions();
    
    printf("\r\n2. 测试启用状态\r\n");
    Motor34_EnablePositionControl();
    Motor34_PrintPositions();
    
    printf("\r\n3. 测试不同的最大步数设置\r\n");
    uint16_t max_steps_values[] = {10, 50, 100, 200};
    for (int i = 0; i < 4; i++) {
        Motor34_SetMaxStepsPerCycle(max_steps_values[i]);
        printf("设置最大步数为 %d:\r\n", max_steps_values[i]);
        Motor34_PrintPositions();
        printf("\r\n");
    }
    
    printf("4. 测试不同的位置设置\r\n");
    Motor34_SetMaxStepsPerCycle(50); // 恢复默认值
    
    // 测试手动设置当前位置
    int32_t test_positions[] = {0, 100, -200, 1000, -500};
    for (int i = 0; i < 5; i++) {
        Motor34_SetCurrentPosition(test_positions[i]);
        Motor34_SetTargetPosition(test_positions[i] + 50); // 目标位置比当前位置多50
        printf("设置当前位置为 %ld，目标位置为 %ld:\r\n", 
               test_positions[i], test_positions[i] + 50);
        Motor34_PrintPositions();
        printf("\r\n");
    }
    
    printf("5. 测试到达目标状态\r\n");
    Motor34_SetCurrentPosition(100);
    Motor34_SetTargetPosition(100); // 当前位置等于目标位置
    Motor34_PrintPositions();
    
    printf("\r\n位置监控调试示例完成\r\n");
}

/**
 * @brief 位置监控性能测试示例
 * 测试位置打印功能的性能影响
 */
void Motor34_Position_Monitor_Performance_Test(void)
{
    printf("=== 步进电机34位置监控性能测试 ===\r\n\r\n");
    
    Motor34_ResetPosition();
    Motor34_SetMaxStepsPerCycle(100);
    Motor34_EnablePositionControl();
    Motor34_SetTargetPosition(500);
    
    printf("测试1: 不使用位置打印的运行时间\r\n");
    uint32_t start_time = HAL_GetTick();
    
    // 运行位置控制但不打印位置信息
    while (!Motor34_IsAtTargetPosition()) {
        Motor34_PositionControl();
        HAL_Delay(20);
    }
    
    uint32_t end_time = HAL_GetTick();
    printf("不打印位置信息的运行时间: %lu ms\r\n", end_time - start_time);
    
    // 重置测试
    Motor34_ResetPosition();
    Motor34_SetTargetPosition(500);
    
    printf("\r\n测试2: 使用位置打印的运行时间\r\n");
    start_time = HAL_GetTick();
    
    // 运行位置控制并每5个周期打印一次位置信息
    int cycle = 0;
    while (!Motor34_IsAtTargetPosition()) {
        if (cycle % 5 == 0) {
            Motor34_PrintPositions();
        }
        Motor34_PositionControl();
        HAL_Delay(20);
        cycle++;
    }
    
    end_time = HAL_GetTick();
    printf("使用位置打印的运行时间: %lu ms\r\n", end_time - start_time);
    printf("总共打印了 %d 次位置信息\r\n", (cycle + 4) / 5);
    
    Motor34_DisablePositionControl();
    printf("\r\n位置监控性能测试完成\r\n");
}

/**
 * @brief 简化位置信息打印函数
 * 提供一个更简洁的位置信息打印方式
 */
void Motor34_PrintPositions_Simple(void)
{
    printf("位置[当前:%ld 目标:%ld 误差:%ld]\r\n", 
           Motor34_GetCurrentPosition(), 
           Motor34_GetTargetPosition(), 
           Motor34_GetPositionError());
}

/**
 * @brief 简化位置监控示例
 * 演示使用简化打印函数的位置监控
 */
void Motor34_Simple_Position_Monitor_Example(void)
{
    printf("=== 步进电机34简化位置监控示例 ===\r\n\r\n");
    
    Motor34_ResetPosition();
    Motor34_SetMaxStepsPerCycle(75);
    Motor34_EnablePositionControl();
    
    // 设置目标位置并使用简化打印
    Motor34_SetTargetPosition(300);
    printf("设置目标位置为300\r\n");
    
    int cycle = 0;
    while (!Motor34_IsAtTargetPosition() && cycle < 20) {
        if (cycle % 2 == 0) {
            printf("周期%2d: ", cycle);
            Motor34_PrintPositions_Simple();
        }
        
        Motor34_PositionControl();
        HAL_Delay(20);
        cycle++;
    }
    
    printf("\r\n最终状态: ");
    Motor34_PrintPositions_Simple();
    
    Motor34_DisablePositionControl();
    printf("\r\n简化位置监控示例完成\r\n");
}

/**
 * @brief 完整的位置监控演示
 * 综合演示所有位置监控功能
 */
void Motor34_Complete_Position_Monitor_Demo(void)
{
    printf("=== 步进电机34完整位置监控演示 ===\r\n\r\n");
    
    // 1. 基本位置监控
    printf("1. 执行基本位置监控示例...\r\n");
    Motor34_Basic_Position_Monitor_Example();
    HAL_Delay(1000);
    
    // 2. 实时位置监控
    printf("\r\n2. 执行实时位置监控示例...\r\n");
    Motor34_Realtime_Position_Monitor_Example();
    HAL_Delay(1000);
    
    // 3. 位置监控调试
    printf("\r\n3. 执行位置监控调试示例...\r\n");
    Motor34_Position_Debug_Example();
    HAL_Delay(1000);
    
    // 4. 简化位置监控
    printf("\r\n4. 执行简化位置监控示例...\r\n");
    Motor34_Simple_Position_Monitor_Example();
    HAL_Delay(1000);
    
    // 5. 性能测试
    printf("\r\n5. 执行位置监控性能测试...\r\n");
    Motor34_Position_Monitor_Performance_Test();
    
    printf("\r\n=== 完整位置监控演示结束 ===\r\n");
    printf("总结：\r\n");
    printf("- Motor34_PrintPositions(): 详细位置信息打印\r\n");
    printf("- Motor34_PrintPositions_Simple(): 简化位置信息打印\r\n");
    printf("- 可用于调试、监控和性能分析\r\n");
    printf("- 建议在调试时使用，生产环境中谨慎使用以避免性能影响\r\n");
}